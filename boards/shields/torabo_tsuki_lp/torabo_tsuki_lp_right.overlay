#include "torabo_tsuki_lp.dtsi"
#include <input/processors.dtsi>
#include <dt-bindings/zmk/input_transform.h>

&trackball_listener {
    status = "okay";
    input-processors = <&zip_xy_transform(3)>;
    scroller {
        layers = <4>;
        input-processors = <
            &zip_xy_transform(0)
            &zip_xy_to_scroll_mapper
        >;
    };
};

&size_s_transform {
    col-offset = <7>;
};

// &size_m_transform {
//     col-offset = <7>;
// };

&size_l_transform {
    col-offset = <7>;
};
